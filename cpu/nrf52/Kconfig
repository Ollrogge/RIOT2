## cpu/nrf52/Kconfig
```kconfig
# Copyright (c) 2020 HAW Hamburg
#
# This file is subject to the terms and conditions of the GNU Lesser
# General Public License v2.1. See the file LICENSE in the top level
# directory for more details.

config CPU_FAM_NRF52
    bool
    select CPU_COMMON_NRF5X
# The ADC does not depend on any board configuration, so always available
    select HAS_PERIPH_ADC
# So far, NimBLE netif does not support nrf51 platforms, so we use a dedicated
# feature to mark this
    select HAS_BLE_NIMBLE_NETIF
# All nrf52s support the 2Mbit PHY mode
    select HAS_BLE_PHY_2MBIT
    select HAS_CORTEXM_MPU
    select HAS_CPU_NRF52
    select HAS_PERIPH_I2C_RECONFIGURE
    select HAS_PERIPH_HASH_SHA1
    select HAS_PERIPH_HASH_SHA224
    select HAS_PERIPH_HASH_SHA256
    select HAS_PERIPH_CIPHER_AES_128
    select HAS_PERIPH_CIPHER_MODE_CBC

## CPU Models
config CPU_MODEL_NRF52805XXAA
    bool
    select CPU_CORE_CORTEX_M4
    select CPU_FAM_NRF52
    select HAS_PERIPH_UART_NONBLOCKING

config CPU_MODEL_NRF52810XXAA
    bool
    select CPU_CORE_CORTEX_M4
    select CPU_FAM_NRF52
    select HAS_PERIPH_UART_NONBLOCKING

config CPU_MODEL_NRF52811XXAA
    bool
    select CPU_CORE_CORTEX_M4
    select CPU_FAM_NRF52
    select HAS_BLE_PHY_CODED
    select HAS_RADIO_NRF802154
    select HAS_PERIPH_UART_NONBLOCKING

config CPU_MODEL_NRF52820XXAA
    bool
    select CPU_CORE_CORTEX_M4
    select CPU_FAM_NRF52
    select HAS_BLE_PHY_CODED
    select HAS_RADIO_NRF802154
    select HAS_PERIPH_UART_NONBLOCKING

config CPU_MODEL_NRF52832XXAA
    bool
    select CPU_FAM_NRF52
    select CPU_CORE_CORTEX_M4F

config CPU_MODEL_NRF52833XXAA
    bool
    select CPU_CORE_CORTEX_M4F
    select CPU_FAM_NRF52
    select HAS_BLE_PHY_CODED
    select HAS_RADIO_NRF802154
    select HAS_PERIPH_UART_NONBLOCKING

config CPU_MODEL_NRF52840XXAA
    bool
    select CPU_CORE_CORTEX_M4F
    select CPU_FAM_NRF52
    select HAS_BLE_PHY_CODED
    select HAS_RADIO_NRF802154
    select HAS_PERIPH_UART_NONBLOCKING

## CPU common symbols
config CPU_FAM
    default "nrf52" if CPU_FAM_NRF52

config CPU_MODEL
    default "nrf52805xxaa" if CPU_MODEL_NRF52805XXAA
    default "nrf52810xxaa" if CPU_MODEL_NRF52810XXAA
    default "nrf52811xxaa" if CPU_MODEL_NRF52811XXAA
    default "nrf52820xxaa" if CPU_MODEL_NRF52820XXAA
    default "nrf52832xxaa" if CPU_MODEL_NRF52832XXAA
    default "nrf52833xxaa" if CPU_MODEL_NRF52833XXAA
    default "nrf52840xxaa" if CPU_MODEL_NRF52840XXAA

config CPU
    default "nrf52" if CPU_FAM_NRF52

config PERIPH_HASHES
    bool
    depends on HAS_CPU_NRF52
    select MODULE_PERIPH_HASHES
    select MODULE_PERIPH_HASHES_COMMON
    select MODULE_PERIPH_PSA_ERROR

config MODULE_PERIPH_HASHES_SHA1
    bool

config MODULE_PERIPH_HASHES_SHA224
    bool

config MODULE_PERIPH_HASHES_SHA256
    bool

config PERIPH_CIPHER_MODE_CBC
    bool
    select MODULE_PERIPH_AES_CBC
    select MODULE_PERIPH_AES_COMMON
    select MODULE_PERIPH_PSA_ERROR


## Definition of specific features
config HAS_CPU_NRF52
    bool
    help
        Indicates that the current cpu is 'nrf52'.

config MODULE_PERIPH_CRYPTOCELL_SETUP
    bool
    help
        Build setup functions for CryptoCell Library

config MODULE_PERIPH_CRYPTOCELL_UTIL
    bool
    help
        Build utility functions for CryptoCell Library

config MODULE_PERIPH_HASHES
    bool
    help
        Use CryptoCell Hardware Driver for Hashes

config CC_HASH_SHA1
    bool
    help
        Indicates that CryptoCell driver is active for SHA-1.

config CC_HASH_SHA224
    bool
    help
        Indicates that CryptoCell driver is active for SHA-1.

config CC_HASH_SHA256
    bool
    help
        Indicates that CryptoCell driver is active for SHA-1.

config MOD_PERIPH_HASH_SHA256
    depends on HAS_CPU_NRF52

config MODULE_PERIPH_HASHES_COMMON
    bool
    help
        Build common hash functions

config MODULE_PERIPH_PSA_ERROR
    bool
    help
        Build PSA Error functions

config PERIPH_CIPHER_AES
    bool

config MODULE_PERIPH_AES_CBC
    bool
    help
        Use CryptoCell Hardware Driver for AES CBC

config MODULE_PERIPH_AES_COMMON
    bool
    help
        Build common AES functions

rsource "periph/Kconfig"
rsource "vectors/Kconfig"
rsource "cryptocell_lib/Kconfig"

source "$(RIOTCPU)/nrf5x_common/Kconfig"
```

## cpu/nrf52/cryptocell_lib/Kconfig
```kconfig
# Copyright (c) 2020 HAW Hamburg
#
# This file is subject to the terms and conditions of the GNU Lesser
# General Public License v2.1. See the file LICENSE in the top level
# directory for more details.
#

config MODULE_LIB_CRYPTOCELL
    bool "CryptoCell Library"
    depends on CPU_FAM_NRF52
    depends on TEST_KCONFIG
    select MODULE_PERIPH_CRYPTOCELL_SETUP
    select MODULE_PERIPH_CRYPTOCELL_UTIL
```

## cpu/nrf52/periph/Kconfig
```kconfig
# Copyright (c) 2021 Inria
#
# This file is subject to the terms and conditions of the GNU Lesser
# General Public License v2.1. See the file LICENSE in the top level
# directory for more details.
#

if TEST_KCONFIG

config MODULE_PERIPH_UART_NONBLOCKING
    depends on HAS_PERIPH_UART_NONBLOCKING
    depends on MODULE_PERIPH_UART
    select MODULE_TSRB

config MODULE_PERIPH_SPI
    depends on HAS_PERIPH_SPI
    select MODULE_PERIPH_GPIO_IRQ if CPU_MODEL_NRF52832XXAA && HAS_PERIPH_GPIO_IRQ

config MODULE_SAUL_NRF_VDDH
    bool "Internal Voltage Sensor"
    depends on HAS_PERIPH_ADC
    select MODULE_PERIPH_ADC

# CryptoCell Related Symbols
config MODULE_PERIPH_CRYPTOCELL_SETUP
    bool
    help
        Build setup functions for CryptoCell Library

config MODULE_PERIPH_CRYPTOCELL_UTIL
    bool
    help
        Build utility functions for CryptoCell Library

config MODULE_PERIPH_PSA_ERROR
    bool
    help
        Build PSA Error functions

# Hash Related Symbols
config PERIPH_HASHES
    bool
    depends on HAS_CPU_NRF52
    select MODULE_PERIPH_HASHES
    select MODULE_PERIPH_HASHES_COMMON
    select MODULE_PERIPH_PSA_ERROR

config MODULE_PERIPH_HASHES
    bool
    help
        Use CryptoCell Hardware Driver for Hashes

config MODULE_PERIPH_HASHES_COMMON
    bool
    help
        Build common hash functions

config MODULE_PERIPH_HASHES_SHA1
    bool

config MODULE_PERIPH_HASHES_SHA224
    bool

config MODULE_PERIPH_HASHES_SHA256
    bool

config MODULE_PERIPH_HASHES_SHA512
    bool

#Cipher Related Symbols
config PERIPH_CIPHER_MODE_CBC
    bool
    select MODULE_PERIPH_AES_CBC
    select MODULE_PERIPH_AES_COMMON
    select MODULE_PERIPH_PSA_ERROR

config PERIPH_CIPHER_AES
    bool

config MODULE_PERIPH_AES_CBC
    bool
    help
        Use CryptoCell Hardware Driver for AES CBC

config MODULE_PERIPH_AES_COMMON
    bool
    help
        Build common AES functions

# Asymmetric Crypto Related Symbols
config PERIPH_ECC
    bool
    select PSA_HAS_OWN_ECC_KEY_TYPE
    select MODULE_PERIPH_ECC
    select MODULE_PERIPH_PSA_ERROR

config PERIPH_ECC_P192
    bool

config MODULE_PERIPH_ECC
    bool
    help
        Build Elliptic Curve functions

endif # TEST_KCONFIG

config HAVE_SAUL_NRF_VDDH
    bool
    select MODULE_SAUL_NRF_VDDH if MODULE_SAUL_DEFAULT
    help
        Indicates that internal voltage sensor is present.
```

## pkg/cryptoauthlib/Kconfig
```kconfig
# Copyright (c) 2020 HAW Hamburg
#
# This file is subject to the terms and conditions of the GNU Lesser
# General Public License v2.1. See the file LICENSE in the top level
# directory for more details.
#

config PACKAGE_CRYPTOAUTHLIB
    bool "Microchip CryptoAuth library"
    select MODULE_CRYPTOAUTHLIB_CONTRIB
    depends on HAS_PERIPH_I2C
    select MODULE_PERIPH_I2C
    select MODULE_ZTIMER
    select ZTIMER_USEC
    imply MODULE_PERIPH_I2C_RECONFIGURE

config MODULE_CRYPTOAUTHLIB_HASHES
    bool "Microchip CryptoAuth library"
    depends on PACKAGE_CRYPTOAUTHLIB

config MODULE_PSA_SE_DRIVER
    bool
    depends on PACKAGE_CRYPTOAUTHLIB

rsource "contrib/Kconfig"
rsource "psa_se_driver/Kconfig"
```

## pkg/cryptoauthlib/contrib/Kconfig
```kconfig
# Copyright (c) 2020 HAW Hamburg
#
# This file is subject to the terms and conditions of the GNU Lesser
# General Public License v2.1. See the file LICENSE in the top level
# directory for more details.
#

config MODULE_CRYPTOAUTHLIB_CONTRIB
    bool
    select MODULE_AUTO_INIT_SECURITY if MODULE_AUTO_INIT
    help
        HAL implementation for the library Microchip CryptoAuth devices.
```

## pkg/cryptoauthlib/psa_se_driver/Kconfig
```kconfig
# Copyright (c) 2021 HAW Hamburg
#
# This file is subject to the terms and conditions of the GNU Lesser
# General Public License v2.1. See the file LICENSE in the top level
# directory for more details.
#

config PSA_CRYPTOAUTHLIB_SE_DRIVER
    bool
    depends on PACKAGE_CRYPTOAUTHLIB
    depends on MODULE_PSA_CRYPTO
```

## pkg/psa_arch_tests/Kconfig
```kconfig
# Copyright (c) 2020 HAW Hamburg
#
# This file is subject to the terms and conditions of the GNU Lesser
# General Public License v2.1. See the file LICENSE in the top level
# directory for more details.
#

config PACKAGE_PSA_ARCH_TESTS
    bool "PSA Architecture Testsuite for the PSA Crypto API"
    depends on MODULE_PSA_CRYPTO
    select MODULE_PSA_ARCH_TESTS_CONTRIB
    select MODULE_FMT

config MODULE_PSA_ARCH_TESTS_CONTRIB
    bool
    help
        RIOT integration code for the PSA Arch Testsuite.
        
```

## pkg/tinycrypt/psa_tinycrypt/Kconfig
```kconfig
# Copyright (c) 2021 HAW Hamburg
#
# This file is subject to the terms and conditions of the GNU Lesser
# General Public License v2.1. See the file LICENSE in the top level
# directory for more details.
#

config MODULE_PSA_TINYCRYPT_HASHES_SHA256
    bool
    depends on PACKAGE_TINYCRYPT
    depends on MODULE_PSA_CRYPTO
    select MODULE_PSA_TINYCRYPT

config MODULE_PSA_TINYCRYPT_CIPHER_AES_CBC
    bool
    depends on PACKAGE_TINYCRYPT
    depends on MODULE_PSA_CRYPTO
    select MODULE_PSA_TINYCRYPT

config MODULE_PSA_TINYCRYPT
    bool
```

## sys/crypto/psa_riot_cipher/Kconfig
```kconfig
# Copyright (c) 2021 HAW Hamburg
#
# This file is subject to the terms and conditions of the GNU Lesser
# General Public License v2.1. See the file LICENSE in the top level
# directory for more details.
#

config MODULE_PSA_RIOT_CIPHER_AES_CBC
    bool
    depends on MODULE_PSA_CRYPTO
    select MODULE_PSA_RIOT_CIPHER
    select MODULE_CIPHER_MODES_CBC

config MODULE_PSA_RIOT_CIPHER
    bool "PSA Cipher APIs"
```

## sys/hashes/Kconfig
```kconfig
# Copyright (c) 2021 HAW Hamburg
#
# This file is subject to the terms and conditions of the GNU Lesser
# General Public License v2.1. See the file LICENSE in the top level
# directory for more details.
#

menu "Hashes"
    depends on TEST_KCONFIG

config MODULE_HASHES_MD5
    bool "MD5 hashing support"
    select MODULE_HASHES

config MODULE_HASHES_SHA1
    bool "SHA-1 hashing support"
    select MODULE_HASHES

config MODULE_HASHES_SHA224
    bool "SHA-224 hashing support"
    select MODULE_HASHES
    select MODULE_HASHES_SHA2XX_COMMON

config MODULE_HASHES_SHA256
    bool "SHA-256 hashing support"
    select MODULE_HASHES
    select MODULE_HASHES_SHA2XX_COMMON

config MODULE_HASHES
    bool "Hash algorithms"
    select MODULE_CRYPTO

config MODULE_HASHES_SHA2XX_COMMON
    bool
    help
        Base module for sha2xx implementations.

endmenu # Hashes
```

## sys/psa/Kconfig
```kconfig
# Copyright (c) 2021 HAW Hamburg
#
# This file is subject to the terms and conditions of the GNU Lesser
# General Public License v2.1. See the file LICENSE in the top level
# directory for more details.
#
menu "PSA Crypto"
    depends on TEST_KCONFIG

menuconfig MODULE_PSA_CRYPTO
    bool "PSA Crypto API Hash Implementation"

if MODULE_PSA_CRYPTO

choice HASHES_MD5_IMPLEMENTATION
    bool "MD5"
    default MODULE_HASHES_SW_MD5

config MODULE_HASHES_SW_MD5
    bool "Software implemented"
    select MODULE_HASHES_MD5

endchoice

choice HASHES_SHA1_IMPLEMENTATION
    bool "SHA-1"
    default MODULE_HASHES_SW_SHA1

config MODULE_HASHES_SW_SHA1
    bool "Software implemented"
    select MODULE_HASHES_SHA1

endchoice

choice HASHES_SHA224_IMPLEMENTATION
    bool "SHA-224"
    default MODULE_HASHES_SW_SHA224

config MODULE_HASHES_SW_SHA224
    bool "Software implemented"
    select MODULE_HASHES_SHA224

endchoice

choice HASHES_SHA256_IMPLEMENTATION
    bool "SHA-256"
    default MODULE_HASHES_SW_SHA256

config MODULE_HASHES_SW_SHA256
    bool "Software implemented"
    select MODULE_HASHES_SHA256

endchoice

endif # MODULE_PSA_CRYPTO

endmenu # PSA_Crypto
```

## sys/psa_crypto/Kconfig
```kconfig
# Copyright (c) 2021 HAW Hamburg
#
# This file is subject to the terms and conditions of the GNU Lesser
# General Public License v2.1. See the file LICENSE in the top level
# directory for more details.
#

menuconfig MODULE_PSA_CRYPTO
    bool "PSA Crypto"
    depends on TEST_KCONFIG
    select MODULE_RANDOM
    select PACKAGE_TLSF

if MODULE_PSA_CRYPTO

menuconfig PSA_HASHES
    bool "PSA Hashes"

if PSA_HASHES
rsource "Kconfig.hashes"
endif # PSA_HASHES

menuconfig PSA_CIPHERS
    bool "PSA Cipher"

if PSA_CIPHERS
rsource "Kconfig.ciphers"
endif # PSA_CIPHERS

menuconfig PSA_ASYMMETRIC
    bool "PSA Asymmetric Crypto"

if PSA_ASYMMETRIC
rsource "Kconfig.asymmetric"
endif # PSA_ASYMMETRIC

menuconfig PSA_SECURE_ELEMENT
    bool "PSA Secure Element Configuration"

if PSA_SECURE_ELEMENT
rsource "Kconfig.se"
endif # PSA_SECURE_ELEMENT

rsource "Kconfig.keysizes"

config PSA_ECC
    bool
    help
        Indicates that an elliptic curve operation is being used

endif # MODULE_PSA_CRYPTO
```

## sys/psa_crypto/Kconfig.asymmetric
```kconfig
# Copyright (c) 2021 HAW Hamburg
#
# This file is subject to the terms and conditions of the GNU Lesser
# General Public License v2.1. See the file LICENSE in the top level
# directory for more details.
#

menuconfig CURVE_ECC_P256
    bool "NIST P256"
    select PSA_CURVE_ECC_KEY_SIZE_256

if CURVE_ECC_P256

choice CURVE_ECC_P256_IMPLEMENTATION
    bool "NISST P256 Implementation"

config CRYPTOAUTHLIB_CURVE_ECC_P256
    bool "Microchip Cryptoauthlib"
    select PACKAGE_CRYPTOAUTHLIB
    select MODULE_PSA_SE_DRIVER
    select PSA_CRYPTO_SECURE_ELEMENT

endchoice

endif # CURVE_ECC_P256

config PSA_CURVE_ECC_KEY_SIZE_256
    bool
    help
        Indicates that an 256 bit Elliptic Curve is used
```
