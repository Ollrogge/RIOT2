## sys/psa_crypto/Kconfig.ciphers
```kconfig
# Copyright (c) 2021 HAW Hamburg
#
# This file is subject to the terms and conditions of the GNU Lesser
# General Public License v2.1. See the file LICENSE in the top level
# directory for more details.
#

menuconfig CIPHER_AES_128
    bool "AES-128"

if CIPHER_AES_128

choice CIPHER_AES_128_IMPLEMENTATION
    bool "AES-128 implementation"
    default PERIPH_CIPHER_AES_128

config RIOT_CIPHER_AES_128
    bool "RIOT Cipher Module"
    select MODULE_CRYPTO
    select MODULE_CRYPTO_AES_128
    select MODULE_PSA_RIOT_CIPHER_AES_CBC

config PERIPH_CIPHER_AES_128
    bool "Hardware Peripheral Implementation"
    depends on HAS_PERIPH_CIPHER_AES_128
    select PERIPH_CIPHER_AES
    select PERIPH_CIPHER_MODE_CBC

config CRYPTOAUTHLIB_CIPHER_AES_128
    bool "Microchip Cryptoauthlib"
    select PACKAGE_CRYPTOAUTHLIB
    select MODULE_PSA_SE_DRIVER
    select PSA_CRYPTO_SECURE_ELEMENT

config PSA_TINYCRYPT_CIPHER_AES_128
    bool "TinyCrypt library as PSA Backend"
    select PACKAGE_TINYCRYPT
    select MODULE_PSA_TINYCRYPT_CIPHER_AES_CBC

endchoice

endif # CIPHER_AES_128

menuconfig CIPHER_AES_192
    bool "AES-192"

if CIPHER_AES_192

choice CIPHER_AES_192_IMPLEMENTATION
    bool "AES-192 implementation"
    default RIOT_CIPHER_AES_192

config RIOT_CIPHER_AES_192
    bool "RIOT Cipher Module"
    select MODULE_CRYPTO
    select MODULE_CRYPTO_AES_192
    select MODULE_PSA_RIOT_CIPHER_AES_CBC

endchoice

endif # CIPHER_AES_192

menuconfig CIPHER_AES_256
    bool "AES-256"

if CIPHER_AES_256

choice CIPHER_AES_256_IMPLEMENTATION
    bool "AES-256 implementation"
    default RIOT_CIPHER_AES_256

config RIOT_CIPHER_AES_256
    bool "RIOT Cipher Module"
    select MODULE_CRYPTO
    select MODULE_CRYPTO_AES_256
    select MODULE_PSA_RIOT_CIPHER_AES_CBC

endchoice

endif # CIPHER_AES_256

config PSA_CRYPTO_SECURE_ELEMENT
    bool
    help
        Indicates a Secure Element is being used
```

## sys/psa_crypto/Kconfig.config
```kconfig
# Copyright (c) 2021 HAW Hamburg
#
# This file is subject to the terms and conditions of the GNU Lesser
# General Public License v2.1. See the file LICENSE in the top level
# directory for more details.
#

menuconfig PSA_SE_CONFIGURATION
    bool "Secure Element Configuration"
    depends on PSA_CRYPTO_SECURE_ELEMENT

if PSA_SE_CONFIGURATION

config PSA_MULTIPLE_SECURE_ELEMENTS
    bool "Use multiple secure elements"

endif # SE_CONFIGURATION

config PSA_CRYPTO_SECURE_ELEMENT
    bool
    help
        Indicates a Secure Element is being used
```

## sys/psa_crypto/Kconfig.hashes
```kconfig
# Copyright (c) 2021 HAW Hamburg
#
# This file is subject to the terms and conditions of the GNU Lesser
# General Public License v2.1. See the file LICENSE in the top level
# directory for more details.
#

menuconfig HASHES_MD5
    bool "MD5"

if HASHES_MD5

choice HASHES_MD5_IMPLEMENTATION
    bool "MD5 implementation"
    default RIOT_HASHES_MD5

config RIOT_HASHES_MD5
    bool "RIOT Hash Module"
    select MODULE_HASHES_MD5
    select MODULE_PSA_RIOT_HASHES_MD5

endchoice

endif # HASHES_MD5

menuconfig HASHES_SHA1
    bool "SHA-1"

if HASHES_SHA1

choice HASHES_SHA1_IMPLEMENTATION
    bool "SHA-1 implementation"
    default PERIPH_HASHES_SHA1

config PERIPH_HASHES_SHA1
    bool "Hardware accelerated"
    depends on HAS_PERIPH_HASH_SHA1
    select PERIPH_HASHES
    select MODULE_PERIPH_HASHES_SHA1

config RIOT_HASHES_SHA1
    bool "RIOT Hash Module"
    select MODULE_HASHES_SHA1
    select MODULE_PSA_RIOT_HASHES_SHA1

endchoice

endif # HASHES_SHA1

menuconfig HASHES_SHA224
    bool "SHA-224"

if HASHES_SHA224

choice HASHES_224_IMPLEMENTATION
    bool "SHA-224 implementation"
    default PERIPH_HASHES_SHA224

config PERIPH_HASHES_SHA224
    bool "Hardware accelerated"
    depends on HAS_PERIPH_HASH_SHA224
    select PERIPH_HASHES
    select MODULE_PERIPH_HASHES_SHA224

config RIOT_HASHES_SHA224
    bool "RIOT Hash Module"
    select MODULE_HASHES_SHA224
    select MODULE_PSA_RIOT_HASHES_SHA224

endchoice

endif # HASHES_SHA224

menuconfig HASHES_SHA256
    bool "SHA-256"

if HASHES_SHA256

choice HASHES_256_IMPLEMENTATION
    bool "SHA-256 implementation"
    default PERIPH_HASHES_SHA256

config PERIPH_HASHES_SHA256
    bool "Hardware accelerated"
    depends on HAS_PERIPH_HASH_SHA256
    select PERIPH_HASHES
    select MODULE_PERIPH_HASHES_SHA256

config RIOT_HASHES_SHA256
    bool "RIOT Hash Module"
    select MODULE_HASHES_SHA256
    select MODULE_PSA_RIOT_HASHES_SHA256

config TINYCRYPT_HASHES_SHA256
    bool "TinyCrypt Library"
    select PACKAGE_TINYCRYPT
    select MODULE_PSA_TINYCRYPT_HASHES_SHA256

endchoice
endif # HASHES_SHA256
```

## sys/psa_crypto/Kconfig.keysizes
```kconfig
# Copyright (c) 2021 HAW Hamburg
#
# This file is subject to the terms and conditions of the GNU Lesser
# General Public License v2.1. See the file LICENSE in the top level
# directory for more details.
#

config PSA_KEY_SIZE_128
    bool

config PSA_KEY_SIZE_192
    bool

config PSA_KEY_SIZE_256
    bool

config PSA_KEY_SIZE_512
    bool

config PSA_MAX_KEY_SIZE
    int
    default 64 if PSA_KEY_SIZE_512
    default 32 if PSA_KEY_SIZE_256
    default 24 if PSA_KEY_SIZE_192
    default 16 if PSA_KEY_SIZE_128
    default 0
```

## sys/psa_crypto/Kconfig.se
```kconfig
# Copyright (c) 2021 HAW Hamburg
#
# This file is subject to the terms and conditions of the GNU Lesser
# General Public License v2.1. See the file LICENSE in the top level
# directory for more details.
#

config PSA_SE_ATECCX08A
    bool "Microchip Cryptoauthlib Driver"
    select PACKAGE_CRYPTOAUTHLIB
    select MODULE_PSA_SE_DRIVER
    select PSA_SECURE_ELEMENT_ECC
    select PSA_KEY_SIZE_256

config PSA_MULTIPLE_SECURE_ELEMENTS
    bool "Use multiple secure elements"

config PSA_SECURE_ELEMENT_ECC
    bool
    help
        Indicate that an ECC Curve Algorithm on a Secure Element is present
```
